## ci/config/west.yml
```yaml
manifest:
  remotes:
    - name: zmkfirmware
      url-base: https://github.com/zmkfirmware
    - name: nxtkb
      url-base: https://github.com/nxtkb
  projects:
    - name: zmk
      remote: zmkfirmware
      revision: 4de313367288aad5aeaa1243890e40dc813f7008
      import: app/west.yml
    - name: Sweep-Pro
      remote: nxtkb
      revision: 9bf146cafbde166aef42b2a6f4ba3f7c1acd8a84
    - name: zmk-feature-codex-micro
      remote: nxtkb
      revision: c53c81697e72ade603e84e7f3c8c5e43a04ddf4c
    - name: zmk-behavior-report
      remote: nxtkb
      revision: 476f43da1f98b4a6150c9c0e499a257bd64a29a0
      import: west.yml
    - name: cirque-input-module
      remote: nxtkb
      revision: 8af03a4c061580c14ec8745caf0fa2dd3fc7f042
  self:
    path: config
```
