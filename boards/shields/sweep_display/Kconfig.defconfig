## boards/shields/sweep_display/Kconfig.defconfig
```kconfig
if SHIELD_SWEEP_DISPLAY

choice ZMK_DISPLAY_STATUS_SCREEN
    default ZMK_DISPLAY_STATUS_SCREEN_CUSTOM
endchoice

choice ZMK_DISPLAY_WORK_QUEUE
    default ZMK_DISPLAY_WORK_QUEUE_DEDICATED
endchoice

choice LV_COLOR_DEPTH
    default LV_COLOR_DEPTH_1
endchoice

config ZMK_DISPLAY_STATUS_SCREEN_CUSTOM
    select LV_USE_LABEL
    select LV_USE_IMAGE
    select LV_USE_FLEX
    imply LV_USE_THEME_MONO if LV_Z_BITS_PER_PIXEL=1
    imply CUSTOM_WIDGET_BATTERY_STATUS
    imply CUSTOM_WIDGET_LAYER_STATUS
    imply CUSTOM_WIDGET_CODEX_STATUS
    imply CUSTOM_WIDGET_OUTPUT_STATUS
    imply CUSTOM_WIDGET_PERIPHERAL_STATUS
    imply CUSTOM_WIDGET_INDICATORS_STATUS

config CUSTOM_WIDGET_BATTERY_STATUS
    bool "Sweep Pro custom battery status widget"
    select LV_USE_LABEL

config CUSTOM_WIDGET_LAYER_STATUS
    bool "Sweep Pro custom layer status widget"
    depends on !ZMK_SPLIT || ZMK_SPLIT_ROLE_CENTRAL
    select LV_USE_LABEL

config CUSTOM_WIDGET_CODEX_STATUS
    bool "Sweep Pro Codex Agent status widget"
    depends on NXTKB_CODEX_MICRO
    depends on !ZMK_SPLIT || ZMK_SPLIT_ROLE_CENTRAL
    select LV_USE_LABEL
    help
      Show Codex Agent state on the auxiliary status row. This option is
      independent from the Codex transport and key behaviors: set
      CONFIG_CUSTOM_WIDGET_CODEX_STATUS=n to keep Codex controls enabled while
      hiding the display widget.

config CUSTOM_WIDGET_TRACKPAD_STATUS
    bool "Sweep Pro custom trackpad status widget"
    depends on !ZMK_SPLIT || ZMK_SPLIT_ROLE_CENTRAL
    select LV_USE_LABEL
    help
      Enable the optional Cirque trackpad status row. This requires the
      cirque-input-module to be present in ZMK_EXTRA_MODULES.

config CUSTOM_WIDGET_AUX_STATUS_LAYOUT
    bool
    default y if CUSTOM_WIDGET_CODEX_STATUS || CUSTOM_WIDGET_TRACKPAD_STATUS
    help
      Internal layout controller shared by the optional Codex and trackpad
      status rows. It is omitted when both widgets are disabled.

choice CUSTOM_AUX_STATUS_DEFAULT_MODE
    prompt "Auxiliary status shown on base layers"
    default CUSTOM_AUX_STATUS_DEFAULT_CODEX if CUSTOM_WIDGET_CODEX_STATUS
    default CUSTOM_AUX_STATUS_DEFAULT_TRACKPAD if CUSTOM_WIDGET_TRACKPAD_STATUS
    default CUSTOM_AUX_STATUS_DEFAULT_NONE

config CUSTOM_AUX_STATUS_DEFAULT_NONE
    bool "Hidden"

config CUSTOM_AUX_STATUS_DEFAULT_CODEX
    bool "Codex Agent status"
    depends on CUSTOM_WIDGET_CODEX_STATUS

config CUSTOM_AUX_STATUS_DEFAULT_TRACKPAD
    bool "Trackpad status"
    depends on CUSTOM_WIDGET_TRACKPAD_STATUS

config CUSTOM_AUX_STATUS_DEFAULT_BOTH
    bool "Codex and trackpad status"
    depends on CUSTOM_WIDGET_CODEX_STATUS && CUSTOM_WIDGET_TRACKPAD_STATUS

endchoice

config CUSTOM_AUX_STATUS_BASE_LAYER_MAX
    int
    default 1

config CUSTOM_AUX_STATUS_MOUSE_LAYER_INDEX
    int
    default 5

config CUSTOM_AUX_STATUS_CODEX_LAYER_INDEX
    int
    default 6

config CUSTOM_WIDGET_OUTPUT_STATUS
    bool "Sweep Pro custom output status widget"
    depends on BT && (!ZMK_SPLIT_BLE || ZMK_SPLIT_ROLE_CENTRAL)
    select LV_USE_LABEL

config CUSTOM_WIDGET_PERIPHERAL_STATUS
    bool "Sweep Pro custom peripheral status widget"
    depends on BT && ZMK_SPLIT_BLE
    select LV_USE_LABEL

config CUSTOM_WIDGET_WPM_STATUS
    bool "Sweep Pro custom WPM status widget"
    depends on !ZMK_SPLIT || ZMK_SPLIT_ROLE_CENTRAL
    select LV_USE_LABEL
    select ZMK_WPM

config CUSTOM_WIDGET_INDICATORS_STATUS
    bool "Sweep Pro custom HID indicators status widget"
    depends on !ZMK_SPLIT || ZMK_SPLIT_ROLE_CENTRAL
    select LV_USE_LABEL
    select ZMK_HID_INDICATORS

config LV_Z_MEM_POOL_SIZE
    default 81920

config LV_Z_VDB_SIZE
    default 10

config LV_DPI_DEF
    default 130

config LV_Z_BITS_PER_PIXEL
    default 1

endif
```

## ci/config/west.yml
```yaml
manifest:
  remotes:
    - name: zmkfirmware
      url-base: https://github.com/zmkfirmware
    - name: nxtkb
      url-base: https://github.com/nxtkb
  projects:
    - name: zmk
      remote: zmkfirmware
      revision: cb615aee9a7c427e251f2ab62080c1a44a165da9
      import: app/west.yml
    - name: Sweep-Pro
      remote: nxtkb
      revision: 286767a76b2317af6ee8eaca03b4755124d42963
    - name: zmk-feature-codex-micro
      remote: nxtkb
      revision: 034050c6cac7834b5004aad510863e7c999f6307
    - name: zmk-behavior-report
      remote: nxtkb
      revision: 476f43da1f98b4a6150c9c0e499a257bd64a29a0
      import: west.yml
    - name: cirque-input-module
      remote: nxtkb
      revision: 8af03a4c061580c14ec8745caf0fa2dd3fc7f042
  self:
    path: config
```
